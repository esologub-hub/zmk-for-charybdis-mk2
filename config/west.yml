## config/west.yml
```yaml
manifest:
  remotes:
    - name: zmkfirmware
      url-base: https://github.com/zmkfirmware
    - name: badjeff
      url-base: https://github.com/badjeff
  projects:
    - name: zmk
      remote: zmkfirmware
      revision: 4dd95d7840eb3d5a3f59bb29fbf1ab054715ef85
      import: app/west.yml
    # Override ZMK's moving fixes branch while retaining its module imports.
    - name: zephyr
      remote: zmkfirmware
      revision: 10ba6d0cb38bc3d258775d27982f707599320085
      import:
        name-blocklist:
          - ci-tools
          - hal_altera
          - hal_cypress
          - hal_infineon
          - hal_microchip
          - hal_nxp
          - hal_openisa
          - hal_xtensa
          - hal_st
          - hal_ti
          - loramac-node
          - mcuboot
          - mcumgr
          - net-tools
          - openthread
          - edtt
          - trusted-firmware-m
    - name: zmk-pmw3610-driver
      remote: badjeff
      revision: 44b4a76b74d293a93cec4ccb7e04cb8d29c10f93

  self:
    path: config
```
